## components/jc8012_bsp/Kconfig
```kconfig
menu "JC8012P4A1C Board Support (local shim)"

    config BSP_LCD_DPI_BUFFER_NUMS
        int "Number of MIPI-DSI frame buffers"
        default 2
        range 1 3
        help
            Number of frame buffers used by the JD9365 MIPI-DSI panel driver.
            The JC8012P4A1C display driver reads this value when creating the
            DPI panel configuration.

    config BSP_DISPLAY_LVGL_AVOID_TEAR
        bool "Avoid tearing effect"
        default y
        help
            Compatibility symbol for the shared sdkconfig.defaults overlay.
            Note: the JC8012P4A1C panel driver runs LVGL with software
            rotation (270 degrees), so avoid-tearing/direct mode is not
            actually used at runtime.

    choice BSP_DISPLAY_LVGL_MODE
        prompt "Select LVGL buffer mode"
        default BSP_DISPLAY_LVGL_DIRECT_MODE
        help
            Compatibility choice for the shared sdkconfig.defaults overlay.

        config BSP_DISPLAY_LVGL_FULL_REFRESH
            bool "Full refresh"

        config BSP_DISPLAY_LVGL_DIRECT_MODE
            bool "Direct mode"

    endchoice

endmenu
```

## main/Kconfig.projbuild
```kconfig
# SPDX-License-Identifier: LicenseRef-FNCL-1.1
# Copyright (c) 2026 Cpt_Kirk
menu "Example Configuration"

menu "Panel Hardware Variant"

choice APP_PANEL_VARIANT
    prompt "Display panel variant"
    default APP_PANEL_VARIANT_4INCH_720
    help
        Select the physical LCD / touch panel this firmware image targets.
        Affects screen resolution (APP_SCREEN_WIDTH/HEIGHT), panel init
        sequence and touch-controller driver selection.

config APP_PANEL_VARIANT_4INCH_720
    bool "4\" 720x720 round (smart86 base)"
    help
        Original smart86 4-inch 720x720 square/round panel.

config APP_PANEL_VARIANT_10INCH_1280
    bool "10.1\" 1280x800 (betta large)"
    help
        10.1-inch 1280x800 panel variant.

config APP_PANEL_VARIANT_10INCH_JC
    bool "10.1\" 1280x800 (Guition JC8012P4A1C)"
    help
        Guition JC8012P4A1C-I-W-Y 10.1-inch 800x1280 MIPI-DSI panel
        (JD9365 controller) with GSL3680 capacitive touch.  Native
        portrait 800x1280, software-rotated to 1280x800 landscape.
        Wi-Fi via ESP-Hosted (C6 coprocessor).

config APP_PANEL_VARIANT_S3_480
    bool "4\" 480x480 (Guition CYD ESP32-S3 4848S040)"
    help
        Guition CYD ESP32-S3 4848S040 4-inch 480x480 RGB panel
        with ST7701S controller and GT911 capacitive touch.
        Native Wi-Fi (no ESP-Hosted/C6 coprocessor).

config APP_PANEL_VARIANT_7INCH_1024
    bool "7\" 1024x600 (Waveshare ESP32-P4-WIFI6-Touch-LCD-7B)"
    help
        Waveshare ESP32-P4-WIFI6-Touch-LCD-7B 7-inch 1024x600
        MIPI-DSI panel (EK79007) with GT911 capacitive touch.

endchoice

endmenu

menu "Application Features"

config APP_FEATURE_CAMERAS
    bool "Camera support (web editor cameras page + camera store)"
    default y
    help
        Enables the cameras page, camera store and the /api/cameras
        routes.  Disable on panels without cameras (e.g. the Guition
        JC8012P4A1C) to drop the camera sources from the build.

config APP_FEATURE_XIAOZHI
    bool "Xiaozhi voice assistant"
    default y
    help
        Enables the Xiaozhi voice-assistant client, audio codec and UI
        page.  Disable on panels that must not run the voice assistant.

endmenu

menu "Local Camera (MIPI-CSI)"

config APP_FEATURE_LOCAL_CAMERA
    bool "Built-in MIPI-CSI camera support"
    default y
    depends on APP_PANEL_VARIANT_10INCH_JC
    help
        Enables the built-in OV02C10 MIPI-CSI camera of the Guition
        JC8012P4A1C panel: snapshot endpoint (/api/camera/snapshot),
        camera status endpoint and motion-based screen wake.

        The camera resolution is selected through the esp_cam_sensor
        (OV02C10) Kconfig, not here.  The JC overlay enables 1080p
        (CONFIG_CAMERA_OV02C10_MIPI_RAW10_1920X1080_30FPS_1_LANE).

config APP_LOCAL_CAMERA_HFLIP
    bool "Horizontally mirror camera image"
    default y
    depends on APP_FEATURE_LOCAL_CAMERA
    help
        Apply a horizontal flip to the captured image.  Default enabled to
        match the official Guition demo orientation.

config APP_LOCAL_CAMERA_VFLIP
    bool "Vertically mirror camera image"
    default n
    depends on APP_FEATURE_LOCAL_CAMERA
    help
        Apply a vertical flip to the captured image.

config APP_LOCAL_CAMERA_MOTION_WAKE
    bool "Wake screen on camera motion"
    default y
    depends on APP_FEATURE_LOCAL_CAMERA
    help
        Use a lightweight frame-difference detector on the camera stream to
        wake the screen (display_note_activity) when someone approaches the
        panel while the display is dimmed or off.

config APP_LOCAL_CAMERA_JPEG_QUALITY
    int "Snapshot JPEG quality (1-100)"
    range 10 95
    default 55
    depends on APP_FEATURE_LOCAL_CAMERA
    help
        JPEG quality used for /api/camera/snapshot.  Higher values produce
        larger images.

endmenu

menu "Wi-Fi Station"

config APP_WIFI_SSID
    string "Wi-Fi SSID"
    default "YOUR_WIFI_SSID"
    help
        SSID of your access point.
        ESP32-C6 supports 2.4 GHz Wi-Fi.

config APP_WIFI_PASSWORD
    string "Wi-Fi Password"
    default "YOUR_WIFI_PASSWORD"
    help
        Password for your access point.
        Set empty only for open networks.

config APP_WIFI_COUNTRY_CODE
    string "Wi-Fi country code (ISO-3166 alpha-2)"
    default "US"
    help
        Two-letter country code used for Wi-Fi regulatory domain
        (for example US, DE, FR). This is used as default and can
        be overridden at runtime in provisioning/settings.

config APP_WIFI_WAIT_FOR_IP
    bool "Wait for IP before continuing boot"
    default y
    help
        If enabled, startup waits until station got IP or timeout.

config APP_WIFI_CONNECT_TIMEOUT_MS
    int "Wi-Fi connect timeout (ms)"
    range 1000 120000
    default 15000
    help
        Maximum time to wait for IP when wait-for-IP is enabled.

config APP_WIFI_MAX_RETRIES
    int "Wi-Fi max reconnect retries"
    range 1 100
    default 8
    help
        Number of reconnect attempts after disconnect.

config APP_WIFI_DISABLE_POWER_SAVE
    bool "Disable Wi-Fi power save (WIFI_PS_NONE)"
    default y
    help
        Forces Wi-Fi modem power-save off on the hosted C6 via esp_wifi_set_ps(WIFI_PS_NONE).
        Recommended for maximum websocket stability.

endmenu

menu "ESP-Hosted"

config APP_HOSTED_AUTO_UPDATE_C6_FW
    bool "Auto-update C6 firmware on version mismatch"
    default y
    depends on ESP_HOSTED_ENABLED
    help
        If enabled, the host runs automatic C6 slave OTA using the bundled
        firmware image whenever running C6 firmware differs from host version,
        including 0.0.0/unknown coprocessor firmware recovery.

endmenu

menu "Home Assistant"

config APP_HA_WS_URL
    string "HA WebSocket URL"
    default "YOUR_HA_WS_URL"
    help
        Example: wss://homeassistant.local:8123/api/websocket

config APP_HA_ACCESS_TOKEN
    string "HA Long-lived Access Token"
    default "YOUR_HA_ACCESS_TOKEN"
    help
        Long-lived access token used for Home Assistant authentication.

config APP_HA_FETCH_INITIAL_STATES
    bool "Fetch initial states after auth_ok"
    default y
    help
        When enabled, the device sends Home Assistant get_states right after
        websocket authentication. This can be memory-intensive on constrained
        links; keep disabled for maximum runtime stability.

config APP_HA_SUBSCRIBE_STATE_CHANGED
    bool "Subscribe to HA state_changed event stream"
    default y
    help
        Enables global Home Assistant state_changed subscription.
        This can produce high event volume; keep disabled while focusing
        on transport stability, then enable once stable.

config APP_HA_PING_INTERVAL_MS
    int "HA ping interval (ms)"
    range 5000 120000
    default 8000
    help
        Periodic Home Assistant websocket "ping" message interval.
        Keeps the application session active even during long idle periods.

endmenu

menu "Time"

config APP_NTP_SERVER
    string "NTP server"
    default "pool.ntp.org"
    help
        NTP server used for time synchronization.

config APP_TIME_TZ
    string "Timezone (POSIX TZ)"
    default "CET-1CEST,M3.5.0/2,M10.5.0/3"
    help
        POSIX timezone string used for localtime conversion.
        Default is Europe/Berlin with automatic DST switching.

endmenu

endmenu
```
